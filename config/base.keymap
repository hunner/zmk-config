#include <behaviors.dtsi>
#include <behaviors/num_word.dtsi> // Requires zmk-auto-layer module.
#include <behaviors/unicode.dtsi> // Requires zmk-unicode module.
#include <zmk-helpers/helper.h> // Requires zmk-helpers module.
#include <dt-bindings/zmk/keys.h>

#include "zmk-helpers/helper.h"
#include "zmk-helpers/unicode-chars/greek.dtsi"
#include "zmk-helpers/unicode-chars/german.dtsi"

#define HELM 0
#define QWERTY 1
#define NIGHT 2
#define PORT 3
#define STARBOARD 4
#define AFT 5
#define TAIPO 6
#define TAIPO_INNER 7
#define TAIPO_OUTER 8
#define TAIPO_MODS_SCAG 1
#define MOUSE 9
#ifndef CRESCENT
#define CRESCENT 10
#endif
#define CRESCENT_LAYER CRESCENT

#include "mouse.dtsi"
#include "combos.dtsi"
#include "leader.dtsi"
#include <zmk-taipo/taipo.dtsi>
#include <zmk-taipo/features/virtual_thumbs.dtsi>
//#include "crescent.dtsi"
#include <zmk-crescent/crescent.dtsi>
#include "xtr_defaults.h"

ZMK_CONDITIONAL_LAYER(aft, PORT STARBOARD, AFT)

/* Navigation keys and misc shortcuts */

&mt {
    flavor = "tap-preferred";
    tapping-term-ms = <220>;
    quick-tap-ms = <220>;              // repeat on tap-into-hold
    hold-trigger-key-positions = <0>;  // tap on interrupt
};

#define NAV_LEFT  &mt HOME     LEFT    // tap: left  | long-tap: beginning of line
#define NAV_RIGHT &mt END      RIGHT   // tap: right | long-tap: end       of line
#define NAV_UP    &mt LC(HOME) UP      // tap: up    | long-tap: beginning of document
#define NAV_DOWN  &mt LC(END)  DOWN    // tap: down  | long-tap: end       of document
#define NAV_BSPC  &mt LC(BSPC) BSPC    // tap: bspc  | long-tap: delete word backward
#define NAV_DEL   &mt LC(DEL)  DEL     // tap: del   | long-tap: delete word forward

#define XXX &none
#define ___ &none

#define CANCEL      &kp K_CANCEL       // cancel caps-word and num-word
#define DSK_PREV    &kp LG(LC(LEFT))   // previous desktop
#define DSK_NEXT    &kp LG(LC(RIGHT))  // next     desktop


#define L_BSPC      &ltp PORT BSPC
#define R_SPC       &lt STARBOARD SPC
#define L_THUMB     L_BSPC
#define R_THUMB     R_SPC
#define PASTE       &kp LS(INSERT)


/* Settings */

#define QUICK_TAP_MS 0

&sk {  // sticky-key config
    //release-after-ms = <600>;  // release after 0.6s
    release-after-ms = <1000>;  // release after 1.0s (the default)
    quick-release;             // no double capitalization when rolling keys
};

&sl {  // sticky-layer config
    ignore-modifiers;
};

&lt {  // layer-tap config
    flavor = "balanced";
    tapping-term-ms = <200>;
    quick-tap-ms = <QUICK_TAP_MS>;
};

// Left thumb only.
//
// "balanced" waits to see which key is released first, so lifting the thumb
// before the other key sends the tap and drops the other key onto the base
// layer. "hold-preferred" commits to the layer as soon as any other key goes
// down, which is what the left thumb wants: its tap is BSPC, and a backspace
// is rarely rolled straight into the next letter.
//
// The right thumb keeps "balanced" on purpose. Its tap is SPC, which is
// followed immediately by a letter constantly, and under "hold-preferred" any
// overlap in that roll turned the starboard layer on: <space>b came out as 3.
ZMK_BEHAVIOR(ltp, hold_tap,
    flavor = "hold-preferred";
    tapping-term-ms = <200>;
    quick-tap-ms = <QUICK_TAP_MS>;
    bindings = <&mo>, <&kp>;
)

&caps_word {  // mods deactivate caps-word, requires PR #1441
    /delete-property/ ignore-modifiers;
};

//&num_word {  // num-word, requires PR #1441
//    layers = <NUM>;
//};

/* Homerow mods */

#define KEYS_L LT0 LT1 LT2 LT3 LT4 LM0 LM1 LM2 LM3 LM4 LB1 LB2 LB3  // left-hand keys
#define KEYS_R RT0 RT1 RT2 RT3 RT4 RM0 RM1 RM2 RM3 RM4 RB1 RB2 RB3  // right-hand keys
#define THUMBS LH0 RH0                                              // thumb keys

ZMK_BEHAVIOR(hml, hold_tap,  // left-hand HRMs
    flavor = "balanced";
    tapping-term-ms = <280>;
    quick-tap-ms = <QUICK_TAP_MS>;
    require-prior-idle-ms = <150>;        // requires PR #1387
    bindings = <&kp>, <&kp>;
    hold-trigger-key-positions = <KEYS_R THUMBS>;
    hold-trigger-on-release;            // requires PR #1423
)

ZMK_BEHAVIOR(hmr, hold_tap,  // right-hand HRMs
    flavor = "balanced";
    tapping-term-ms = <280>;
    quick-tap-ms = <QUICK_TAP_MS>;
    require-prior-idle-ms = <150>;        // requires PR #1387
    bindings = <&kp>, <&kp>;
    hold-trigger-key-positions = <KEYS_L THUMBS>;
    hold-trigger-on-release;            // requires PR #1423
)

// Shift, without the require-prior-idle-ms gate the other mods keep.
//
// That gate forces a tap whenever another key was pressed in the preceding
// 150ms, which is what stops a fast roll turning into an accidental mod. A
// capital mid-word is that exact pattern though, so shift lost every race:
// reaching for the right shift to type I gave si, and the left shift for L in
// Long gave along, each pinky emitting its own letter instead of holding.
//
// The other mods keep the gate. Ctrl, alt, and gui are nearly always pressed
// after a pause, so it costs them nothing and still catches their misfires.
ZMK_BEHAVIOR(hmls, hold_tap,  // left-hand shift
    flavor = "balanced";
    tapping-term-ms = <280>;
    quick-tap-ms = <QUICK_TAP_MS>;
    bindings = <&kp>, <&kp>;
    hold-trigger-key-positions = <KEYS_R THUMBS>;
    hold-trigger-on-release;
)

ZMK_BEHAVIOR(hmrs, hold_tap,  // right-hand shift
    flavor = "balanced";
    tapping-term-ms = <280>;
    quick-tap-ms = <QUICK_TAP_MS>;
    bindings = <&kp>, <&kp>;
    hold-trigger-key-positions = <KEYS_L THUMBS>;
    hold-trigger-on-release;
)

/* Custom behaviors */

// tap: num-word | hold: num-layer
ZMK_BEHAVIOR(num_layer_word, hold_tap,
    flavor = "balanced";
    tapping-term-ms = <200>;
    quick-tap-ms = <QUICK_TAP_MS>;
    bindings = <&mo>, <&num_word>;
)
#define NUM_WORD &num_layer_word NUM 0

// tap: sticky shift | double tap: capsword | triple tap: cancel capsword
// ZMK_BEHAVIOR(ss_cw, tap_dance,
//     tapping-term-ms = <200>;
//     bindings = <&sk LSHFT>, <&caps_word>, <CANCEL>;
// )
// tap: sticky-shift | lshft + tap: caps-word | hold: shift
ZMK_BEHAVIOR(ss_cw, mod_morph,
    bindings = <&sk LSHFT>, <&caps_word>;
    mods = <(MOD_LSFT)>;
)

// tap: backspace | lshft + tap: delete | rshft + tap: shift-delete | hold: num layer
//ZMK_BEHAVIOR(bs_del_sys, mod_morph,
//    bindings = <&lt SYS BSPC>, <&kp DEL>;
//    mods = <(MOD_LSFT|MOD_RSFT)>;
//    keep-mods = <MOD_LSFT>;  // requires PR #1412
//)

// tap: space | space + tap: dot -> space -> sticky shift | hold: activate layer
ZMK_BEHAVIOR(dot_spc, macro,
    wait-ms = <0>;
    tap-ms = <5>;
    bindings = <&kp DOT &kp SPACE &sk LSHFT>;
)
ZMK_BEHAVIOR(spc_morph, mod_morph,
    bindings = <&kp SPACE>, <&dot_spc>;
    mods = <(MOD_LSFT|MOD_RSFT)>;
)
ZMK_BEHAVIOR(lt_spc, hold_tap,
    flavor = "balanced";
    tapping-term-ms = <200>;
    quick-tap-ms = <QUICK_TAP_MS>;
    bindings = <&mo>, <&spc_morph>;
)

ZMK_BEHAVIOR(copy_cut, tap_dance,
    tapping-term-ms = <200>;
    bindings = <&kp LC(INS)>, <&kp LC(X)>;
)

// Windows sleep key
ZMK_BEHAVIOR(win_sleep, macro,
    wait-ms = <100>;
    tap-ms = <5>;
    bindings = <&kp LG(X) &kp U &kp S>;
)

// Sticky layer + sticky shift (workaround for issue #1421)
// ZMK_BEHAVIOR(uc_shift, macro,
//     wait-ms = <0>;
//     tap-ms = <1>;
//     bindings = <&macro_press &mo UC &kp LSHFT>
//              , <&macro_pause_for_release>
//              , <&macro_release &mo UC &kp LSHFT>;
// )
// ZMK_BEHAVIOR(sls, sticky_key,
//     release-after-ms = <1000>;
//     bindings = <&uc_shift>;
//     ignore-modifiers;
// )

// tap: comma | shift + tap: semicolon | ctrl + shift + tap: <
ZMK_BEHAVIOR(dot_inner_morph, mod_morph,
    bindings = <&kp DOT>, <&kp COLON>;
    mods = <(MOD_LSFT|MOD_RSFT)>;
)
ZMK_BEHAVIOR(dot_morph, mod_morph,
    bindings = <&dot_inner_morph>, <&kp DOT>;
    mods = <(MOD_LCTL|MOD_RCTL)>;
)

// tap: dot | shift + tap: colon | ctrl + shift + tap: >
ZMK_BEHAVIOR(comma_inner_morph, mod_morph,
    bindings = <&kp COMMA>, <&kp SEMICOLON>;
    mods = <(MOD_LSFT|MOD_RSFT)>;
)
ZMK_BEHAVIOR(comma_morph, mod_morph,
    bindings = <&comma_inner_morph>, <&kp COMMA>;
    mods = <(MOD_LCTL|MOD_RCTL)>;
)

/* Keymap */
    //╭──────╮ ╭─────────────┬─────────────┬─────────────┬─────────────┬─────────────╮ ╭──────╮  ╭─────────────┬─────────────┬─────────────┬─────────────┬─────────────╮╭──────╮
    //├──────┤ ├─────────────┼─────────────┼─────────────┼─────────────┼─────────────┤ ├──────┤  ├─────────────┼─────────────┼─────────────┼─────────────┼─────────────┤├──────┤
    //├──────┤ ╰─────────────┼─────────────┼─────────────┼─────────────┼─────────────╯ ├──────┤  ╰─────────────┼─────────────┼─────────────┼─────────────┼─────────────╯├──────┤
    //├──────┤               ╰─────────────┴─────────────┴─────────────╯               ├──────┤                ╰─────────────┴─────────────┴─────────────╯              ├──────┤
    //╰──────╯                                                                         ╰──────╯                                                                         ╰──────╯

//                                                                        ╭─────────────┬─────────────┬─────────────┬─────────────┬─────────────╮

//                                                                        ├─────────────┼─────────────┼─────────────┼─────────────┼─────────────┤

//                                                                        ╰─────────────┼─────────────┼─────────────┼─────────────┼─────────────╯

//                                            ^                                         ╰─────────────┴─────────────┴─────────────╯

//                                                                        ╭─────────────┬─────────────┬─────────────┬─────────────┬─────────────╮
#define LEFT_HELM_UPPER_ROW________________________________________________ &kp Z         &kp X         &kp B         &kp P         &kp Y
//                                                                        ├─────────────┼─────────────┼─────────────┼─────────────┼─────────────┤
#define LEFT_HELM_MIDDLE_ROW_______________________________________________ &hmls LSHFT A  &hml LCTRL O  &hml LALT E   &hml LGUI U   &kp I
//                                                                        ╰─────────────┼─────────────┼─────────────┼─────────────┼─────────────╯
#define LEFT_HELM_LOWER_ROW____________________                                           &kp Q         &kp J         &kp K
//                                            ^                                         ╰─────────────┴─────────────┴─────────────╯

//                                                                        ╭─────────────┬─────────────┬─────────────┬─────────────┬─────────────╮
#define RIGHT_HELM_UPPER_ROW_______________________________________________ &kp F         &kp G         &kp C         &kp R         &kp L
//                                                                        ├─────────────┼─────────────┼─────────────┼─────────────┼─────────────┤
#define RIGHT_HELM_MIDDLE_ROW______________________________________________ &kp D         &hmr RGUI H   &hmr RALT T   &hmr RCTRL N  &hmrs RSHFT S
//                                                                        ╰─────────────┼─────────────┼─────────────┼─────────────┼─────────────╯
#define RIGHT_HELM_LOWER_ROW___________________                                           &kp M         &kp W         &kp V
//                                            ^                                         ╰─────────────┴─────────────┴─────────────╯

//                                                                        ╭─────────────┬─────────────┬─────────────┬─────────────┬─────────────╮
#define LEFT_PORT_UPPER_ROW________________________________________________ &kp SQT       &kp COMMA     &kp DOT       &kp SEMI      &kp PGUP
//                                                                        ├─────────────┼─────────────┼─────────────┼─────────────┼─────────────┤
#define LEFT_PORT_MIDDLE_ROW_______________________________________________ &kp LBRC      &kp RBRC      &kp LPRN      &kp RPRN      &kp PGDN
//                                                                        ╰─────────────┼─────────────┼─────────────┼─────────────┼─────────────╯
#define LEFT_PORT_LOWER_ROW____________________                                           &kp GRAVE     &kp LBKT      &kp RBKT
//                                            ^                                         ╰─────────────┴─────────────┴─────────────╯

//                                                                        ╭─────────────┬─────────────┬─────────────┬─────────────┬─────────────╮
#define RIGHT_PORT_UPPER_ROW_______________________________________________ &kp HOME      ___           ___           &kp BSLH      ___
//                                                                        ├─────────────┼─────────────┼─────────────┼─────────────┼─────────────┤
#define RIGHT_PORT_MIDDLE_ROW______________________________________________ &kp END       &kp EQUAL     &kp SLASH     &kp PLUS      &kp MINUS
//                                                                        ╰─────────────┼─────────────┼─────────────┼─────────────┼─────────────╯
#define RIGHT_PORT_LOWER_ROW___________________                                           ___           ___           ___
//                                            ^                                         ╰─────────────┴─────────────┴─────────────╯

//                                                                        ╭─────────────┬─────────────┬─────────────┬─────────────┬─────────────╮
#define LEFT_STARBOARD_UPPER_ROW___________________________________________ &kp N1        &kp N2        &kp N3        &kp N4        &kp N5
//                                                                        ├─────────────┼─────────────┼─────────────┼─────────────┼─────────────┤
#define LEFT_STARBOARD_MIDDLE_ROW__________________________________________ ___           ___           ___           ___           ___
//                                                                        ╰─────────────┼─────────────┼─────────────┼─────────────┼─────────────╯
#define LEFT_STARBOARD_LOWER_ROW_______________                                           &to TAIPO     &to CRESCENT  &to NIGHT
//                                            ^                                         ╰─────────────┴─────────────┴─────────────╯

//                                                                        ╭─────────────┬─────────────┬─────────────┬─────────────┬─────────────╮
#define RIGHT_STARBOARD_UPPER_ROW__________________________________________ &kp N6        &kp N7        &kp N8        &kp N9        &kp N0
//                                                                        ├─────────────┼─────────────┼─────────────┼─────────────┼─────────────┤
#define RIGHT_STARBOARD_MIDDLE_ROW_________________________________________ ___           &kp LEFT      &kp DOWN      &kp UP        &kp RIGHT
//                                                                        ╰─────────────┼─────────────┼─────────────┼─────────────┼─────────────╯
#define RIGHT_STARBOARD_LOWER_ROW______________                                           &to QWERTY    ___           &to HELM
//                                            ^                                         ╰─────────────┴─────────────┴─────────────╯

//                                                                        ╭─────────────┬─────────────┬─────────────┬─────────────┬─────────────╮
#define LEFT_AFT_UPPER_ROW_________________________________________________ &kp F1        &kp F2        &kp F3        &kp F4        &kp F5
//                                                                        ├─────────────┼─────────────┼─────────────┼─────────────┼─────────────┤
#define LEFT_AFT_MIDDLE_ROW________________________________________________ &kp F11       &kp F12       &kp INSERT    &kp DELETE    PASTE
//                                                                        ╰─────────────┼─────────────┼─────────────┼─────────────┼─────────────╯
#define LEFT_AFT_LOWER_ROW_____________________                                           &mkp LCLK     &mkp RCLK     &mkp MCLK
//                                            ^                                         ╰─────────────┴─────────────┴─────────────╯

//                                                                        ╭─────────────┬─────────────┬─────────────┬─────────────┬─────────────╮
#define RIGHT_AFT_UPPER_ROW________________________________________________ &kp F6        &kp F7        &kp F8        &kp F9        &kp F10
//                                                                        ├─────────────┼─────────────┼─────────────┼─────────────┼─────────────┤
#define RIGHT_AFT_MIDDLE_ROW_______________________________________________ &msc SCRL_LEFT &mmv MOVE_LEFT &mmv MOVE_DOWN &mmv MOVE_UP &mmv MOVE_RIGHT
//                                                                        ╰─────────────┼─────────────┼─────────────┼─────────────┼─────────────╯
#define RIGHT_AFT_LOWER_ROW____________________                                           &msc SCRL_DOWN &msc SCRL_UP &msc SCRL_RIGHT
//                                            ^                                         ╰─────────────┴─────────────┴─────────────╯

#define MOUSE_SCROLL_________________________________________ &msc SCRL_LEFT &msc SCRL_DOWN &msc SCRL_UP &msc SCRL_RIGHT
#define MOUSE_MOVE___________________________________________ &mmv MOVE_LEFT &mmv MOVE_DOWN &mmv MOVE_UP &mmv MOVE_RIGHT
#define MOUSE_BUTTONS__________________________               &mkp LCLK      &mkp MCLK      &mkp RCLK
//                                            ^

/*
ZMK_LAYER(helm_layer,
    //╭──────╮ ╭─────────────┬─────────────┬─────────────┬─────────────┬─────────────╮ ╭──────╮  ╭─────────────┬─────────────┬─────────────┬─────────────┬─────────────╮╭──────╮
        X_LT     &kp Z         &kp X         &kp B         &kp P         &kp Y           X_MT      &kp F         &kp G         &kp C         &kp R         &kp L          X_RT
    //├──────┤ ├─────────────┼─────────────┼─────────────┼─────────────┼─────────────┤ ├──────┤  ├─────────────┼─────────────┼─────────────┼─────────────┼─────────────┤├──────┤
        X_LM     &hmls LSHFT A  &hml LCTRL O  &hml LALT E   &hml LGUI U   &kp I           X_MM      &kp D         &hmr RGUI H   &hmr RALT T   &hmr RCTRL N  &hmrs RSHFT S   X_RM
    //├──────┤ ╰─────────────┼─────────────┼─────────────┼─────────────┼─────────────╯ ├──────┤  ╰─────────────┼─────────────┼─────────────┼─────────────┼─────────────╯├──────┤
    //├──────┤               ╰─────────────┴─────────────┴─────────────╯               ├──────┤                ╰─────────────┴─────────────┴─────────────╯              ├──────┤
    //╰──────╯                                                                         ╰──────╯                                                                         ╰──────╯
                      &kp Q         &kp J         &kp K                                         &kp M         &kp W         &kp V

ZMK_LAYER(qwerty_layer,
    // ╭─────────────┬─────────────┬─────────────┬─────────────┬─────────────╮   ╭─────────────┬─────────────┬─────────────┬─────────────┬─────────────╮
        &kp Q         &kp W         &kp E         &kp R         &kp T             &kp Y         &kp U         &kp I         &kp O         &kp P
    // ├─────────────┼─────────────┼─────────────┼─────────────┼─────────────┤   ├─────────────┼─────────────┼─────────────┼─────────────┼─────────────┤
        &hmls LSHFT A  &hml LCTRL S  &hml LALT D   &hml LGUI F   &kp G             &kp H         &hmr RGUI J   &hmr RALT K   &hmr RCTRL L  &hmrs RSHFT BSPC
    // ╰─────────────┼─────────────┼─────────────┼─────────────┼─────────────┤   ├─────────────┼─────────────┼─────────────┼─────────────┼─────────────╯
                      &kp Z         &kp X         &kp C         &ltp PORT V        R_THUMB       &kp M         &kp N         &kp B
    //               ╰─────────────┴─────────────┼─────────────┼─────────────╯   ╰─────────────┴─────────────┼─────────────┼─────────────╯
)

ZMK_LAYER(aptmak_layer,
    // v w f p b j l u y '
    // r s t h k x n a i o
    //   c g d     m , .
    //           e
    // c+g=z, c+d=q
    // ╭─────────────┬─────────────┬─────────────┬─────────────┬─────────────╮   ╭─────────────┬─────────────┬─────────────┬─────────────┬─────────────╮
        &kp V         &kp W         &kp F         &kp P         &kp B             &kp J         &kp L         &kp U         &kp Y         &kp SQT
    // ├─────────────┼─────────────┼─────────────┼─────────────┼─────────────┤   ├─────────────┼─────────────┼─────────────┼─────────────┼─────────────┤
        &hml LGUI R   &hml LALT S   &hml LCTRL T  &hmls LSHFT H  &kp K             &kp X         &hml RSHFT N  &hml RCTRL A  &hml RALT I   &hml RGUI O
    // ╰─────────────┼─────────────┼─────────────┼─────────────┼─────────────┤   ├─────────────┼─────────────┼─────────────┼─────────────┼─────────────╯
                      &kp C         &kp G         &kp D         PORT_SP           STARB_E       &kp M         &kp COMMA     &kp DOT
    //               ╰─────────────┴─────────────┼─────────────┼─────────────╯   ╰─────────────┴─────────────┼─────────────┼─────────────╯
)

ZMK_LAYER(port_layer,
    // ╭─────────────┬─────────────┬─────────────┬─────────────┬─────────────╮   ╭─────────────┬─────────────┬─────────────┬─────────────┬─────────────╮
        &kp SQT       &kp COMMA     &kp DOT       &kp SEMI      &kp PGUP          &kp HOME      ___           ___           &kp BSLH      ___
    // ├─────────────┼─────────────┼─────────────┼─────────────┼─────────────┤   ├─────────────┼─────────────┼─────────────┼─────────────┼─────────────┤
        &kp LBRC      &kp RBRC      &kp LPRN      &kp RPRN      &kp PGDN          &kp END       &kp EQUAL     &kp SLASH     &kp PLUS      &kp MINUS
    // ╰─────────────┼─────────────┼─────────────┼─────────────┼─────────────┤   ├─────────────┼─────────────┼─────────────┼─────────────┼─────────────╯
                      &kp GRAVE     &kp LBKT      &kp RBKT      L_THUMB           R_THUMB       ___           ___           ___
    //               ╰─────────────┴─────────────┼─────────────┼─────────────╯   ╰─────────────┴─────────────┼─────────────┼─────────────╯
)

ZMK_LAYER(starboard_layer,
    // ╭─────────────┬─────────────┬─────────────┬─────────────┬─────────────╮   ╭─────────────┬─────────────┬─────────────┬─────────────┬─────────────╮
        &kp N1        &kp N2        &kp N3        &kp N4        &kp N5            &kp N6        &kp N7        &kp N8        &kp N9        &kp N0
    // ├─────────────┼─────────────┼─────────────┼─────────────┼─────────────┤   ├─────────────┼─────────────┼─────────────┼─────────────┼─────────────┤
        ___           ___           ___           ___           ___               ___           &kp LEFT      &kp DOWN      &kp UP        &kp RIGHT
    // ╰─────────────┼─────────────┼─────────────┼─────────────┼─────────────┤   ├─────────────┼─────────────┼─────────────┼─────────────┼─────────────╯
                      &to TAIPO     &to STENO     &to APTMAK    L_THUMB           R_THUMB       &to QWERTY    ___           &to HELM
    //               ╰─────────────┴─────────────┼─────────────┼─────────────╯   ╰─────────────┴─────────────┼─────────────┼─────────────╯
)

ZMK_LAYER(aft_layer,
    // ╭─────────────┬─────────────┬─────────────┬─────────────┬─────────────╮   ╭─────────────┬─────────────┬─────────────┬─────────────┬─────────────╮
        &kp F1        &kp F2        &kp F3        &kp F4        &kp F5            &kp F6        &kp F7        &kp F8        &kp F9        &kp F10
    // ├─────────────┼─────────────┼─────────────┼─────────────┼─────────────┤   ├─────────────┼─────────────┼─────────────┼─────────────┼─────────────┤
        &kp F11       &kp F12       &kp INSERT    &kp DELETE    PASTE             &msc SCROLL_LEFT &mmv MOVE_LEFT &mmv MOVE_DOWN &mmv MOVE_UP &mmv MOVE_RIGHT
    // ╰─────────────┼─────────────┼─────────────┼─────────────┼─────────────┤   ├─────────────┼─────────────┼─────────────┼─────────────┼─────────────╯
                      &mkp LCLK     &mkp RCLK     &mkp MCLK     L_THUMB           R_THUMB       &msc SCROLL_DOWN &msc SCROLL_UP &msc SCROLL_RIGHT
    //               ╰─────────────┴─────────────┼─────────────┼─────────────╯   ╰─────────────┴─────────────┼─────────────┼─────────────╯
)

ZMK_LAYER(taipo_layer,
    // ╭─────────────┬─────────────┬─────────────┬─────────────┬─────────────╮   ╭─────────────┬─────────────┬─────────────┬─────────────┬─────────────╮
        &kp R         &kp S         &kp N         &kp I         ___               ___           &kp I         &kp N         &kp S         &kp R
    // ├─────────────┼─────────────┼─────────────┼─────────────┼─────────────┤   ├─────────────┼─────────────┼─────────────┼─────────────┼─────────────┤
        &kp A         &kp O         &kp T         &kp E         ___               ___           &kp E         &kp T         &kp O         &kp A
    // ╰─────────────┼─────────────┼─────────────┼─────────────┼─────────────┤   ├─────────────┼─────────────┼─────────────┼─────────────┼─────────────╯
                      &to HELM      ___           &kp SPACE     &kp BSPC          &kp BSPC      &kp SPACE     ___           ___
    //               ╰─────────────┴─────────────┼─────────────┼─────────────╯   ╰─────────────┴─────────────┼─────────────┼─────────────╯
)

ZMK_LAYER(steno_layer,
    // ╭─────────────┬─────────────┬─────────────┬─────────────┬─────────────╮   ╭─────────────┬─────────────┬─────────────┬─────────────┬─────────────╮
        &kp S         &kp T         &kp E         &kp N         &kp O             ___           ___           ___           ___           ___
    // ├─────────────┼─────────────┼─────────────┼─────────────┼─────────────┤   ├─────────────┼─────────────┼─────────────┼─────────────┼─────────────┤
        ___           ___           ___           ___           ___               ___           ___           ___           ___           ___
    // ╰─────────────┼─────────────┼─────────────┼─────────────┼─────────────┤   ├─────────────┼─────────────┼─────────────┼─────────────┼─────────────╯
                      &to HELM      ___           ___           ___               ___           ___           ___           ___
    //               ╰─────────────┴─────────────┼─────────────┼─────────────╯   ╰─────────────┴─────────────┼─────────────┼─────────────╯
)
*/

/* vim: set tw=180 ft=c: */
